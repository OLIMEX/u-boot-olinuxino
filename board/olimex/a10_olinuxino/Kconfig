## board/olimex/a10_olinuxino/Kconfig
```kconfig
if TARGET_A10_OLINUXINO
config SYS_BOARD
	default "a10_olinuxino"

config SYS_VENDOR
	default "olimex"

config SYS_CONFIG_NAME
	default "a10_olinuxino"
endif
```

## board/olimex/a13_olinuxino/Kconfig
```kconfig
if TARGET_A13_OLINUXINO
config SYS_BOARD
	default "a13_olinuxino"

config SYS_VENDOR
	default "olimex"

config SYS_CONFIG_NAME
	default "a13_olinuxino"
endif
```

## board/olimex/a20_olinuxino/Kconfig
```kconfig
if TARGET_A20_OLINUXINO
config SYS_BOARD
	default "a20_olinuxino"

config SYS_VENDOR
	default "olimex"

config SYS_CONFIG_NAME
	default "a20_olinuxino"
endif
```

## board/olimex/a64_olinuxino/Kconfig
```kconfig
if TARGET_A64_OLINUXINO
config SYS_BOARD
	default "a64_olinuxino"

config SYS_VENDOR
	default "olimex"

config SYS_CONFIG_NAME
	default "a64_olinuxino"
endif
```

## board/olimex/stm32mp1_olinuxino/Kconfig
```kconfig
if TARGET_OLIMEX_STM32MP1

config SYS_BOARD
	default "stm32mp1_olinuxino"

config SYS_VENDOR
	default "olimex"

config SYS_CONFIG_NAME
	default "stm32mp1"

source "board/st/common/Kconfig"
endif
```

## configs/A10-OLinuXino_defconfig
```kconfig
CONFIG_ARM=y
CONFIG_ARCH_SUNXI=y
CONFIG_NR_DRAM_BANKS=1
CONFIG_SPL=y
CONFIG_MACH_SUN4I=y
CONFIG_DRAM_CLK=480
CONFIG_DRAM_EMR1=4
CONFIG_SYS_CLK_FREQ=912000000
CONFIG_MMC0_CD_PIN="PH1"
CONFIG_I2C1_ENABLE=y
CONFIG_SATAPWR="PC3"
CONFIG_MMC_SUNXI_SLOT_EXTRA=2
CONFIG_AHCI=y
# CONFIG_SYS_MALLOC_CLEAR_ON_INIT is not set
CONFIG_USE_PREBOOT=y
CONFIG_SPL_I2C_SUPPORT=y
# CONFIG_SPL_DOS_PARTITION is not set
# CONFIG_SPL_EFI_PARTITION is not set
CONFIG_DEFAULT_DEVICE_TREE="sun4i-a10-olinuxino-lime"
CONFIG_SYS_RELOC_GD_ENV_ADDR=y
CONFIG_SCSI_AHCI=y
CONFIG_MII=y
CONFIG_SUN4I_EMAC=y
CONFIG_AXP_ALDO3_VOLT=2800
CONFIG_AXP_ALDO4_VOLT=2800
CONFIG_SCSI=y
CONFIG_USB_EHCI_HCD=y
CONFIG_USB_OHCI_HCD=y
CONFIG_SYS_USB_EVENT_POLL_VIA_INT_QUEUE=y

CONFIG_TARGET_A10_OLINUXINO=y
CONFIG_SPL_BOARD_INIT=y
CONFIG_BOARD_LATE_INIT=y
CONFIG_OF_BOARD_FIXUP=y
CONFIG_MMC_BROKEN_CD=y
CONFIG_MULTI_DTB_FIT=y
CONFIG_OF_LIST="sun4i-a10-olinuxino-lime sun4i-a10-olinuxino-lime-emmc"
CONFIG_ENV_FAT_DEVICE_AND_PART=""

CONFIG_SPI=y
CONFIG_DM_SPI=y
CONFIG_DM_SPI_FLASH=y
CONFIG_SPI_FLASH=y
CONFIG_SPI_SUNXI=y
CONFIG_SPL_SPI_SUNXI=y
CONFIG_SPI_FLASH_MTD=y
CONFIG_SPI_FLASH_WINBOND=y
CONFIG_SYS_SPI_U_BOOT_OFFS=0x8000

CONFIG_ENV_IS_IN_EXT4=y
CONFIG_ENV_EXT4_INTERFACE="mmc"
CONFIG_ENV_EXT4_DEVICE_AND_PART=""
CONFIG_ENV_EXT4_FILE="/uboot.env"
CONFIG_FIT_BEST_MATCH=y
```

## configs/A13-OLinuXino_defconfig
```kconfig
CONFIG_ARM=y
CONFIG_ARCH_SUNXI=y
CONFIG_SPL=y
CONFIG_MACH_SUN5I=y
CONFIG_DRAM_CLK=360
CONFIG_DRAM_EMR1=0
CONFIG_MMC0_CD_PIN="PG0"
CONFIG_USB0_VBUS_DET="PG1"
CONFIG_USB1_VBUS_PIN="PG11"
CONFIG_AXP_GPIO=y
# CONFIG_VIDEO_HDMI is not set
CONFIG_VIDEO_VGA_VIA_LCD=y
CONFIG_VIDEO_VGA_VIA_LCD_FORCE_SYNC_ACTIVE_HIGH=y
CONFIG_VIDEO_LCD_POWER="AXP0-0"
CONFIG_VIDEO_LCD_BL_PWM="PB2"
CONFIG_DEFAULT_DEVICE_TREE="sun5i-a13-olinuxino"
# CONFIG_SYS_MALLOC_CLEAR_ON_INIT is not set
CONFIG_SPL_I2C_SUPPORT=y
CONFIG_CMD_DFU=y
CONFIG_CMD_USB_MASS_STORAGE=y
CONFIG_DFU_RAM=y
CONFIG_FASTBOOT_CMD_OEM_FORMAT=y
CONFIG_AXP_ALDO3_VOLT=3300
CONFIG_CONS_INDEX=2
CONFIG_TARGET_A13_OLINUXINO=y
CONFIG_SPL_BOARD_INIT=y
CONFIG_BOARD_LATE_INIT=y
CONFIG_OF_BOARD_FIXUP=y
CONFIG_MMC_BROKEN_CD=y
CONFIG_MULTI_DTB_FIT=y
CONFIG_OF_LIST="sun5i-a13-olinuxino sun5i-a13-som-256 sun5i-a13-som-512"
CONFIG_USB_EHCI_HCD=y
CONFIG_USB_OHCI_HCD=y
CONFIG_USB_MUSB_GADGET=y
CONFIG_ENV_FAT_DEVICE_AND_PART=""

CONFIG_ENV_OVERWRITE=y
CONFIG_ENV_IS_IN_EXT4=y
CONFIG_ENV_EXT4_INTERFACE="mmc"
CONFIG_ENV_EXT4_DEVICE_AND_PART="0:auto"
CONFIG_ENV_EXT4_FILE="/uboot.env"
CONFIG_FIT_BEST_MATCH=y

CONFIG_ENV_ACCESS_IGNORE_FORCE=y
```

## configs/A20-OLinuXino_defconfig
```kconfig
CONFIG_ARM=y
CONFIG_ARCH_SUNXI=y
CONFIG_NR_DRAM_BANKS=1
CONFIG_SPL=y
CONFIG_MACH_SUN7I=y
CONFIG_DRAM_CLK=384
CONFIG_MMC_SUNXI_SLOT_EXTRA=2
CONFIG_AHCI=y
# CONFIG_SYS_MALLOC_CLEAR_ON_INIT is not set
CONFIG_USE_PREBOOT=y
CONFIG_SPL_I2C_SUPPORT=y
CONFIG_CMD_DFU=y
CONFIG_CMD_USB_MASS_STORAGE=y
# CONFIG_SPL_DOS_PARTITION is not set
# CONFIG_SPL_PARTITION_UUIDS is not set
CONFIG_DEFAULT_DEVICE_TREE="sun7i-a20-olinuxino-micro"
CONFIG_SYS_RELOC_GD_ENV_ADDR=y
CONFIG_SCSI_AHCI=y
CONFIG_DFU_RAM=y
CONFIG_FASTBOOT_CMD_OEM_FORMAT=y
CONFIG_ETH_DESIGNWARE=y
CONFIG_RGMII=y
CONFIG_MII=y
CONFIG_SUN7I_GMAC=y
CONFIG_AXP_ALDO3_VOLT=2800
CONFIG_AXP_ALDO3_VOLT_SLOPE_08=y
CONFIG_AXP_ALDO3_INRUSH_QUIRK=y
CONFIG_AXP_ALDO4_VOLT=2800
CONFIG_SCSI=y
CONFIG_USB_EHCI_HCD=y
CONFIG_USB_OHCI_HCD=y
CONFIG_USB_MUSB_GADGET=y
CONFIG_SYS_USB_EVENT_POLL_VIA_INT_QUEUE=y
# CONFIG_PHY_ADDR_ENABLE is not set

CONFIG_TARGET_A20_OLINUXINO=y
CONFIG_SPL_BOARD_INIT=y
CONFIG_BOARD_LATE_INIT=y
CONFIG_OF_BOARD_FIXUP=y
CONFIG_MMC_BROKEN_CD=y
CONFIG_MULTI_DTB_FIT=y
CONFIG_OF_LIST="sun7i-a20-olinuxino-micro sun7i-a20-olinuxino-micro-emmc sun7i-a20-olinuxino-lime sun7i-a20-olinuxino-lime-emmc sun7i-a20-olinuxino-lime2 sun7i-a20-olinuxino-lime2-emmc sun7i-a20-olimex-som-evb sun7i-a20-olimex-som-evb-emmc sun7i-a20-olimex-som204-evb sun7i-a20-olimex-som204-evb-emmc"

CONFIG_CMD_SF=y
CONFIG_CMD_SF_TEST=y

CONFIG_SPI=y
CONFIG_DM_SPI=y
CONFIG_DM_SPI_FLASH=y
CONFIG_SPI_FLASH=y
CONFIG_SPI_SUNXI=y
CONFIG_SPL_SPI_SUNXI=y
CONFIG_SPI_FLASH_MTD=y
CONFIG_SPI_FLASH_WINBOND=y
CONFIG_SYS_SPI_U_BOOT_OFFS=0x8000

CONFIG_ENV_FAT_DEVICE_AND_PART=""

CONFIG_ENV_OVERWRITE=y
CONFIG_ENV_IS_IN_EXT4=y
CONFIG_ENV_EXT4_INTERFACE="mmc"
CONFIG_ENV_EXT4_DEVICE_AND_PART=""
CONFIG_ENV_EXT4_FILE="/uboot.env"

CONFIG_ENV_ACCESS_IGNORE_FORCE=y

CONFIG_VIDEO_LCD_PANEL_OLINUXINO=y
CONFIG_VIDEO_LCD_DCLK_PHASE-0
CONFIG_FIT_BEST_MATCH=y
CONFIG_SUN4I_EMAC=y

CONFIG_PHY_SMSC=y
CONFIG_PHY_MICREL=y
CONFIG_PHY_MICREL_KSZ90X1=y
```

## configs/A64-OLinuXino_defconfig
```kconfig
CONFIG_ARM=y
CONFIG_ARCH_SUNXI=y
CONFIG_NR_DRAM_BANKS=1
CONFIG_SPL=y
CONFIG_SPL_BOARD_INIT=y
CONFIG_MACH_SUN50I=y
CONFIG_TARGET_A64_OLINUXINO=y
CONFIG_RESERVE_ALLWINNER_BOOT0_HEADER=y
CONFIG_MMC_SUNXI_SLOT_EXTRA=2
# CONFIG_SYS_MALLOC_CLEAR_ON_INIT is not set
CONFIG_USE_PREBOOT=y
# CONFIG_CMD_FLASH is not set
# CONFIG_SPL_DOS_PARTITION is not set
# CONFIG_SPL_EFI_PARTITION is not set
CONFIG_OF_BOARD_FIXUP=y
CONFIG_DEFAULT_DEVICE_TREE="sun50i-a64-olinuxino"
CONFIG_SUN8I_EMAC=y
CONFIG_USB_EHCI_HCD=y
CONFIG_USB_OHCI_HCD=y
CONFIG_SYS_USB_EVENT_POLL_VIA_INT_QUEUE=y

CONFIG_ENV_OVERWRITE=y
# CONFIG_ENV_IS_IN_FAT is not set
CONFIG_ENV_IS_IN_EXT4=y
CONFIG_ENV_EXT4_INTERFACE="mmc"
CONFIG_ENV_EXT4_DEVICE_AND_PART="0:auto"
CONFIG_ENV_EXT4_FILE="/uboot.env"

CONFIG_ENV_ACCESS_IGNORE_FORCE=y

CONFIG_SPI=y
CONFIG_DM_SPI=y
CONFIG_SPI_SUNXI=y
CONFIG_SPL_SPI_SUNXI=y
CONFIG_CMD_SF=y
CONFIG_CMD_SF_TEST=y
CONFIG_DM_SPI_FLASH=y
CONFIG_SPI_FLASH=y
CONFIG_SPI_FLASH_WINBOND=y
CONFIG_SPI_FLASH_MTD=y
CONFIG_DISPLAY_BOARDINFO=y
CONFIG_FIT_BEST_MATCH=y

CONFIG_VIDEO_BPP8=y
CONFIG_VIDEO_BPP16=y
CONFIG_VIDEO_BPP32=y
CONFIG_VIDEO_ANSI=y
CONFIG_LAST_STAGE_INIT=y

CONFIG_CMD_I2C=y
CONFIG_SPL_LOAD_FIT=y
CONFIG_MULTI_DTB_FIT=y
CONFIG_OF_LIST="sun50i-a64-olinuxino sun50i-a64-olinuxino-emmc"

CONFIG_USB_MUSB_GADGET=y
CONFIG_USB_GADGET_DOWNLOAD=y
CONFIG_CMD_USB_MASS_STORAGE=y
CONFIG_USB_MUSB_PIO_ONLY=y
```
